/******************************************************
*环境：MC9S12XS128   总线频率48M
*如果您的环境与我们的不一样，请将IIC通信延时进行调整
*OLED屏在没有调通前，是无显示的，即黑屏，请耐心调试
*该程序经过验证OK
*SCL----PB6
*SDA----PB7
*IIC默认地址0X78
*VCC接3.3V，IO口直接单片机，不需要上拉电阻或串联电阻
*CS接地
* 我们的邮箱：779100562@qq.com
*邮件里请说明问题及销售单号，以便我们及时根据您的订单进行有针对性的指导服务，谢谢
*******************************************************/
#include <hidef.h>      /* common defines and macros */
#include "derivative.h"      /* derivative-specific definitions */



#define high 1
#define low 0 
/*************Pin Define***************/
#define  SCL PORTB_PB6
#define  SDA PORTB_PB7
/****************************************************/
void Initial_LY096BG30();
void Delay_50ms(unsigned int Del_50ms);
void Delay_1ms(unsigned int Del_1ms);
void fill_picture(unsigned char fill_Data);
void IIC_Start();
void IIC_Stop();
void Write_IIC_Command(unsigned char IIC_Command);
void Write_IIC_Data(unsigned char IIC_Data);
void Write_IIC_Byte(unsigned char IIC_Byte);

void Delay_1ms(unsigned int Del_1ms)		//
{
	unsigned char j;
	while(Del_1ms--)
	{	
		for(j=0;j<2;j++);
	}
}
/***********************Initial code*********************/
void Initial_LY096BG30()
{
	Write_IIC_Command(0xAE);   //display off
	Write_IIC_Command(0x20);	//Set Memory Addressing Mode	
	Write_IIC_Command(0x10);	//00,Horizontal Addressing Mode;01,Vertical Addressing Mode;10,Page Addressing Mode (RESET);11,Invalid
	Write_IIC_Command(0xb0);	//Set Page Start Address for Page Addressing Mode,0-7
	Write_IIC_Command(0xc8);	//Set COM Output Scan Direction
	Write_IIC_Command(0x00);//---set low column address
	Write_IIC_Command(0x10);//---set high column address
	Write_IIC_Command(0x40);//--set start line address
	Write_IIC_Command(0x81);//--set contrast control register
	Write_IIC_Command(0x7f);
	Write_IIC_Command(0xa1);//--set segment re-map 0 to 127
	Write_IIC_Command(0xa6);//--set normal display
	Write_IIC_Command(0xa8);//--set multiplex ratio(1 to 64)
	Write_IIC_Command(0x3F);//
	Write_IIC_Command(0xa4);//0xa4,Output follows RAM content;0xa5,Output ignores RAM content
	Write_IIC_Command(0xd3);//-set display offset
	Write_IIC_Command(0x00);//-not offset
	Write_IIC_Command(0xd5);//--set display clock divide ratio/oscillator frequency
	Write_IIC_Command(0xf0);//--set divide ratio
	Write_IIC_Command(0xd9);//--set pre-charge period
	Write_IIC_Command(0x22); //
	Write_IIC_Command(0xda);//--set com pins hardware configuration
	Write_IIC_Command(0x12);
	Write_IIC_Command(0xdb);//--set vcomh
	Write_IIC_Command(0x20);//0x20,0.77xVcc
	Write_IIC_Command(0x8d);//--set DC-DC enable
	Write_IIC_Command(0x14);//
	Write_IIC_Command(0xaf);//--turn on oled panel 
}

/**********************************************
//IIC Start
**********************************************/
void IIC_Start()
{
   SCL = high;
   Delay_1ms(1);		
   SDA = high;
   Delay_1ms(1);
   SDA = low;
  Delay_1ms(1);
   SCL = low;
  Delay_1ms(1);
}

/**********************************************
//IIC Stop
**********************************************/
void IIC_Stop()
{
   SCL = low;
   Delay_1ms(1);
   SDA = low;
   Delay_1ms(1);
   SCL = high;
   Delay_1ms(1);
   SDA = high;
   Delay_1ms(1);
}
/**********************************************
// IIC Write byte
**********************************************/
void Write_IIC_Byte(unsigned char IIC_Byte)
{
	unsigned char i;
	for(i=0;i<8;i++)		
	{
		if(IIC_Byte & 0x80)		//1?0?
		{
		  
		SDA=high;
		}
		else 
		{
		  
		SDA=low;
		}
	Delay_1ms(1);
		SCL=high;
	Delay_1ms(1);
		SCL=low;
	Delay_1ms(1);
		IIC_Byte<<=1;			//loop
	}
	SDA=1;
Delay_1ms(1);
	SCL=1;
Delay_1ms(1);
	SCL=0;
Delay_1ms(1);
}
/**********************************************
// IIC Write Command
**********************************************/
void Write_IIC_Command(unsigned char IIC_Command)
{
   IIC_Start();
   Write_IIC_Byte(0x78);            //Slave address,SA0=0
   Write_IIC_Byte(0x00);			//write command
   Write_IIC_Byte(IIC_Command); 
   IIC_Stop();
}
/**********************************************
// IIC Write Data
**********************************************/
void Write_IIC_Data(unsigned char IIC_Data)
{
   IIC_Start();
   Write_IIC_Byte(0x78);			
   Write_IIC_Byte(0x40);			//write data
   Write_IIC_Byte(IIC_Data);
   IIC_Stop();
}
/********************************************
// fill_Picture
********************************************/
void fill_picture(unsigned char fill_Data)
{
	unsigned char m,n;
	for(m=0;m<8;m++)
	{
		Write_IIC_Command(0xb0+m);		//page0-page1
		Write_IIC_Command(0x00);		//low column start address
		Write_IIC_Command(0x10);		//high column start address
		for(n=0;n<128;n++)
			{
				Write_IIC_Data(fill_Data);
			}
	}
}


/***********************Delay****************************************/
void Delay_50ms(unsigned int Del_50ms)		//
{
	unsigned int m;
	for(;Del_50ms>0;Del_50ms--)
		for(m=6245;m>0;m--);
}





void Delay(unsigned int delay_m)
{
    int delay_i,delay_j;
    for(delay_i=0;delay_i<200;delay_i++)
    for(delay_j=0;delay_j<delay_m;delay_j++)
    {
    }
}
/***********************Picture Code**************************/
unsigned char show1[]=
{
0x00,0x06,0x0A,0xFE,0x0A,0xC6,0x00,0xE0,0x00,0xF0,0x00,0xF8,0x00,0x00,0x00,0x00,
0x00,0x00,0xFE,0x7D,0xBB,0xC7,0xEF,0xEF,0xEF,0xEF,0xEF,0xEF,0xEF,0xC7,0xBB,0x7D,
0xFE,0x00,0x00,0x00,0x00,0x00,0x00,0x00,0x00,0x00,0x00,0x00,0x00,0x00,0x00,0x00,
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0x40,0x50,0x20,0x5F,0x80,0x00,0x1F,0x20,0x40,0x40,0x40,0x50,0x20,0x5F,0x80,0x00,
};
/******************************************
// picture
******************************************/
void picture_1()
{
  unsigned char x,y;
  unsigned int i=0;
  for(y=0;y<8;y++)
    {
      Write_IIC_Command(0xb0+y);
      Write_IIC_Command(0x00);
      Write_IIC_Command(0x10);
      for(x=0;x<128;x++)
        {
          Write_IIC_Data(show1[i++]);
        }
    }
}

void main(void) 
{
  /* put your own code here */
  	unsigned char i;
  int  sci_r=23;
  Delay(100);
  Delay(100);
  Delay(100);
	//EnableInterrupts;
   DDRM=0xff;
   DDRJ=0XFF;
   DDRB=0xff;
   Pll_Init();
   Sci_Init();
   
  Initial_LY096BG30();
	Delay(5);
	while(1)
	{

			PTJ_PTJ0=~PTJ_PTJ0;
      PTJ_PTJ1=~PTJ_PTJ1;  
     

		//fill_picture(0xff);
			//Delay(2500);
		//fill_picture(0x00);
			Delay(2500);
			picture_1();
			Delay(2500);

	}


} /* loop forever */
  /* please make sure that you never leave main */

